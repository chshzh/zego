## modules/led/Kconfig.zego_led
```kconfig
#
# Copyright (c) 2026 Nordic Semiconductor ASA
# SPDX-License-Identifier: LicenseRef-Nordic-5-Clause
#

config ZEGO_LED
	bool "Zego LED module"
	depends on DK_LIBRARY
	help
	  Enable the shared Zego LED module. Provides a simple LED state API
	  driven by zbus messages from other modules.

if ZEGO_LED

module = ZEGO_LED
module-str = zego_led
source "subsys/logging/Kconfig.template.log_config"

endif # ZEGO_LED
```

## modules/network/Kconfig.zego_network
```kconfig
#
# Copyright (c) 2026 Nordic Semiconductor ASA
# SPDX-License-Identifier: LicenseRef-Nordic-5-Clause
#

config ZEGO_NETWORK
	bool "Zego network module"
	depends on WIFI
	help
	  Enable the shared Zego Wi-Fi network module. Manages STA / AP / P2P
	  connection lifecycle and publishes connectivity events on zbus.

if ZEGO_NETWORK

module = ZEGO_NETWORK
module-str = zego_network
source "subsys/logging/Kconfig.template.log_config"

endif # ZEGO_NETWORK
```

## modules/wifi/Kconfig
```kconfig
#
# Copyright (c) 2026 Nordic Semiconductor ASA
# SPDX-License-Identifier: LicenseRef-Nordic-5-Clause
#

config ZEGO_WIFI
        bool "Zego Wi-Fi module (mode selector + banner)"
        depends on NETWORKING && ZBUS
        help
          Provides:
            - Startup banner: app name, version, PRD, specs, build date, board, MAC.
            - WIFI_MODE_CHAN: zbus channel published at SYS_INIT APPLICATION priority 0.
            - zego_wifi_get_mode(): returns the active Wi-Fi mode.
            - zego_banner_wifi_info(): mode string + per-mode connection instructions.
            - zego_banner_app_extra(): Kconfig-conditional compiled-module list.
            - zego_wifi_print_banner(): called from each app's main().
          When NRF70_AP_MODE or NRF70_P2P_MODE is enabled, ZEGO_WIFI_MODE_SELECTOR
          is auto-enabled to persist the active mode in NVS.  STA-only builds skip
          NVS entirely — WIFI_MODE_CHAN is published as STA directly from wifi.c.

config ZEGO_WIFI_MODE_SELECTOR
	bool
	depends on ZEGO_WIFI
	default y if NRF70_AP_MODE || NRF70_P2P_MODE
	select SETTINGS
	select FLASH
	select FLASH_MAP
	select FLASH_PAGE_LAYOUT
	select REBOOT
	help
	  Automatically enabled when more than one Wi-Fi mode is available
	  (NRF70_AP_MODE or NRF70_P2P_MODE).  Stores the active mode as a
	  uint8_t in NVS under "app/app_wifi_mode" and registers the
	  'app_wifi_mode' shell command.  Changing the enum order in wifi.h
	  without erasing NVS will corrupt the stored value.
	  When disabled (STA-only builds) no NVS or settings access occurs.

if ZEGO_WIFI

if ZEGO_WIFI_MODE_SELECTOR

choice ZEGO_WIFI_DEFAULT_MODE
	prompt "Default Wi-Fi mode on fresh flash (no NVS key present)"
	default ZEGO_WIFI_DEFAULT_MODE_STA
	help
	  Selects the mode used when NVS has no stored value (e.g. first boot
	  after --erase).  The 'app_wifi_mode' shell command can change it at
	  any time; the board reboots to apply the change.

config ZEGO_WIFI_DEFAULT_MODE_STA
	bool "STA — join an existing Wi-Fi network"

config ZEGO_WIFI_DEFAULT_MODE_SOFTAP
	bool "SoftAP — create an access point"
	depends on NRF70_AP_MODE

config ZEGO_WIFI_DEFAULT_MODE_P2P_GO
	bool "P2P Group Owner (Wi-Fi Direct)"
	depends on NRF70_P2P_MODE

config ZEGO_WIFI_DEFAULT_MODE_P2P_CLIENT
	bool "P2P Client — join a peer's P2P group"
	depends on NRF70_P2P_MODE

endchoice

endif # ZEGO_WIFI_MODE_SELECTOR

module = ZEGO_WIFI
module-str = zego_wifi
source "${ZEPHYR_BASE}/subsys/logging/Kconfig.template.log_config"

endif # ZEGO_WIFI
```

## nordic-wifi-app-template/src/modules/ux/Kconfig
```kconfig
# Copyright (c) 2026 Nordic Semiconductor ASA
# SPDX-License-Identifier: LicenseRef-Nordic-5-Clause

config APP_UX_MODULE
	bool "Application UX module (button gestures + LED Wi-Fi feedback)"
	depends on ZEGO_BUTTON && ZEGO_LED && ZEGO_WIFI && REBOOT && SETTINGS
	default n
	help
	  Provides out-of-box UX for Button 0 and LED 0.

	  Button 0 gestures:
	    Single click  — print current Wi-Fi mode to UART log
	    Double-click  — toggle BLE provisioning LED (nRF54LM20DK only;
	                    full BLE prov toggle requires CONFIG_ZEGO_WIFI_BLE_PROV=y)
	    Long press    — cycle Wi-Fi mode (STA → SoftAP → P2P_GO → P2P_CLIENT → STA),
	                    save to NVS, reboot

	  LED 0 Wi-Fi state:
	    Boot / connecting → ROTATE
	    STA/P2P connected → Solid ON
	    SoftAP active     → Slow BLINK (500 ms half-period)
	    BLE prov active   → BREATHE (triggered by double-click)
	    Error / disconn.  → Fast BLINK (100 ms half-period)

if APP_UX_MODULE

config APP_UX_INIT_PRIORITY
	int "UX module SYS_INIT priority"
	default 95
	help
	  Must be higher (later) than ZEGO_LED_INIT_PRIORITY (91) and
	  ZEGO_BUTTON_INIT_PRIORITY (90) so LED and button are ready before
	  the UX module starts ROTATE and registers observers.

config APP_UX_ROTATE_FIRST_LED
	int "First LED index in the Wi-Fi ROTATE sequence"
	default 0
	range 0 8
	help
	  Index of the first LED included in the Wi-Fi connecting/softap ROTATE
	  effect.  Consecutive indices from this value are used; count is set by
	  APP_UX_ROTATE_COUNT.  Leave both at 0 to let the LED module use its
	  own ROTATE_NUM_LEDS default (indices 0..ROTATE_NUM_LEDS-1).

config APP_UX_ROTATE_COUNT
	int "Number of LEDs in the Wi-Fi ROTATE sequence"
	default 0
	range 0 9
	help
	  How many consecutive LEDs (starting from APP_UX_ROTATE_FIRST_LED) to
	  include in the rotate sweep.  0 means fall back to the LED module
	  default (CONFIG_ZEGO_LED_ROTATE_NUM_LEDS consecutive LEDs from 0).
	  Example — rotate RGB2 only on nRF5340 Audio DK: FIRST_LED=3, COUNT=3.

config APP_UX_CONNECTED_LED
	int "LED index turned ON when Wi-Fi is connected"
	default 0
	range 0 8
	help
	  0-based LED index driven solid-ON for the CONNECTED state.
	  Default 0 (all boards).  Set to 4 on nRF5340 Audio DK to light the
	  green channel of RGB2.

config APP_UX_CONNECTED_LED_GREEN_ONLY
	bool "Turn off adjacent LEDs for a pure-colour connected indicator"
	default n
	help
	  When enabled, the CONNECTED handler also sends LED_COMMAND_OFF to
	  (CONNECTED_LED - 1) and (CONNECTED_LED + 1) so only the target
	  colour channel is lit.  Use on nRF5340 Audio DK where LED 4 is the
	  green channel of RGB2 (red = LED 3, blue = LED 5).

endif # APP_UX_MODULE
```

## west.yml
```yaml
# Copyright (c) 2026 Nordic Semiconductor ASA
# SPDX-License-Identifier: LicenseRef-Nordic-5-Clause

manifest:
  version: "0.13"

  defaults:
    remote: ncs

  remotes:
    - name: ncs
      url-base: https://github.com/nrfconnect
    - name: chshzh
      url-base: https://github.com/chshzh

  projects:
    # NCS v3.4.0 — imports zephyr, bootloader, modules, nrfxlib, tools, etc.
    - name: sdk-nrf
      path: nrf
      revision: v3.4.0
      import: true
      remote: ncs

    # Application projects — add/remove as needed
    # - name: nordic-wifi-webdash
    #   path: nordic-wifi-webdash
    #   revision: main
    #   remote: chshzh

    # - name: nordic-wifi-memfault
    #   path: nordic-wifi-memfault
    #   revision: main
    #   remote: chshzh

    # - name: nordic-wifi-audio
    #   path: nordic-wifi-audio
    #   revision: main
    #   remote: chshzh


    # - name: claude
    #   path: .claude
    #   revision: main
    #   remote: chshzh

    - name: zview
      url: https://github.com/chshzh/zview
      revision: main
      path: modules/tools/zview
      west-commands: scripts/west-commands.yml
    

  self:
    path: zego
```

## wifi/Kconfig
```kconfig
#
# Copyright (c) 2026 Nordic Semiconductor ASA
# SPDX-License-Identifier: LicenseRef-Nordic-5-Clause
#

config ZEGO_WIFI
        bool "Zego Wi-Fi module (mode selector + banner)"
        depends on NETWORKING && ZBUS
        select SETTINGS
        select FLASH
        select FLASH_MAP
        select FLASH_PAGE_LAYOUT
        select REBOOT
        help
          Provides:
            - Startup banner: app name, version, PRD, specs, build date, board, MAC.
            - Wi-Fi mode selector: NVS-persisted mode + 'app_wifi_mode' shell command.
            - zego_banner_wifi_info(): mode string + per-mode connection instructions.
            - zego_banner_app_extra(): Kconfig-conditional compiled-module list.
            - zego_wifi_print_banner(): called from each app's main().
	  Publishes WIFI_MODE_CHAN at SYS_INIT APPLICATION priority 0.

if ZEGO_WIFI

choice ZEGO_WIFI_DEFAULT_MODE
	prompt "Default Wi-Fi mode on fresh flash (no NVS key present)"
	default ZEGO_WIFI_DEFAULT_MODE_STA
	help
	  Selects the mode used when NVS has no stored value (e.g. first boot
	  after --erase).  The 'app_wifi_mode' shell command can change it at
	  any time; the board reboots to apply the change.

config ZEGO_WIFI_DEFAULT_MODE_STA
	bool "STA — join an existing Wi-Fi network"

config ZEGO_WIFI_DEFAULT_MODE_SOFTAP
	bool "SoftAP — create an access point"
	depends on NRF70_AP_MODE

config ZEGO_WIFI_DEFAULT_MODE_P2P_GO
	bool "P2P Group Owner (Wi-Fi Direct)"
	depends on NRF70_P2P_MODE

config ZEGO_WIFI_DEFAULT_MODE_P2P_CLIENT
	bool "P2P Client — join a peer's P2P group"
	depends on NRF70_P2P_MODE

endchoice

module = ZEGO_WIFI
module-str = zego_wifi
source "${ZEPHYR_BASE}/subsys/logging/Kconfig.template.log_config"

endif # ZEGO_WIFI
```
