## prj.conf
```kconfig
# SPDX-License-Identifier: LicenseRef-Nordic-5-Clause
#
# Zego LED sample — manual hardware test harness.
#
# Build:
#   nrfutil sdk-manager toolchain launch --ncs-version=v3.3.0 -- \
#     west build -b nrf7002dk/nrf5340/cpuapp -p \
#     -d zego/led/sample/build_7002dk zego/led/sample
#
#   nrfutil sdk-manager toolchain launch --ncs-version=v3.3.0 -- \
#     west build -b nrf54lm20dk/nrf54lm20a/cpuapp -p \
#     -d zego/led/sample/build_54lm20dk zego/led/sample
#
# Flash:
#   nrfutil sdk-manager toolchain launch --ncs-version=v3.3.0 -- \
#     west flash -d zego/led/sample/build_7002dk --dev-id <SN>

CONFIG_ZEGO_LED=y

# Show state-change debug lines as well as step INFO lines.
CONFIG_ZEGO_LED_LOG_LEVEL_DBG=y

CONFIG_LOG=y
CONFIG_LOG_DEFAULT_LEVEL=3

# Tune these to experiment with effect timing:
# CONFIG_ZEGO_LED_BLINK_PERIOD_MS=250
# CONFIG_ZEGO_LED_BREATHE_PERIOD_MS=3000
# CONFIG_ZEGO_LED_BREATHE_PWM_PERIOD_MS=20
# CONFIG_ZEGO_LED_ROTATE_PERIOD_MS=300
```

## boards/nrf54lm20dk_nrf54lm20a_cpuapp.conf
```kconfig
# nRF54LM20DK — 4 user LEDs (LED0 = index 0, LED1 = index 1, LED2 = index 2, LED3 = index 3)
CONFIG_ZEGO_LED_NUM_LEDS=4
CONFIG_ZEGO_LED_BACKEND_DK=y
```

## boards/nrf7002dk_nrf5340_cpuapp.conf
```kconfig
# nRF7002DK — 2 user LEDs (LED1 = index 0, LED2 = index 1)
CONFIG_ZEGO_LED_NUM_LEDS=2
CONFIG_ZEGO_LED_BACKEND_DK=y
```

## src/main.c
```c
/*
 * Copyright (c) 2026 Nordic Semiconductor ASA
 * SPDX-License-Identifier: LicenseRef-Nordic-5-Clause
 *
 * Zego LED sample — manual hardware test harness.
 *
 * Walks through every LED command type so you can verify behaviour on real
 * hardware.  Subscribes to LED_STATE_CHAN and logs every hardware state change
 * at DEBUG level.  Step announcements are at INFO level.
 *
 * LED index-to-silkscreen mapping:
 *   nRF7002DK    — idx 0 = LED1,  idx 1 = LED2
 *   nRF54LM20DK  — idx 0 = LED0,  idx 1 = LED1,  idx 2 = LED2,  idx 3 = LED3
 */

#include <zephyr/kernel.h>
#include <zephyr/logging/log.h>
#include "led.h"

LOG_MODULE_REGISTER(led_sample, LOG_LEVEL_DBG);

/* --------------------------------------------------------------------------
 * LED_STATE_CHAN subscriber — echoes every hardware state change
 * -------------------------------------------------------------------------- */

static const char *cmd_name(enum led_msg_type cmd)
{
	switch (cmd) {
	case LED_COMMAND_ON:
		return "ON";
	case LED_COMMAND_OFF:
		return "OFF";
	case LED_COMMAND_TOGGLE:
		return "TOGGLE";
	case LED_COMMAND_BLINK:
		return "BLINK";
	case LED_COMMAND_BREATHE:
		return "BREATHE";
	case LED_COMMAND_MARQUEE:
		return "MARQUEE";
	default:
		return "?";
	}
}

static void on_led_state(const struct zbus_channel *chan)
{
	const struct led_state_msg *s = zbus_chan_const_msg(chan);

	LOG_DBG("  state: LED%d -> %s  (cmd=%s)", s->led_number, s->is_on ? "ON" : "OFF",
		cmd_name(s->command));
}

ZBUS_LISTENER_DEFINE(led_sample_listener, on_led_state);
ZBUS_CHAN_ADD_OBS(LED_STATE_CHAN, led_sample_listener, 0);

/* --------------------------------------------------------------------------
 * Helpers
 * -------------------------------------------------------------------------- */

static void led_cmd(uint8_t n, enum led_msg_type type, uint16_t period_ms)
{
	struct led_msg msg = {.type = type, .led_number = n, .period_ms = period_ms};
	int ret = zbus_chan_pub(&LED_CMD_CHAN, &msg, K_NO_WAIT);

	if (ret < 0) {
		LOG_ERR("LED_CMD_CHAN pub failed: %d", ret);
	}
}

static void all_off(void)
{
	for (uint8_t i = 0; i < CONFIG_ZEGO_LED_NUM_LEDS; i++) {
		led_cmd(i, LED_COMMAND_OFF, 0);
	}
}

/* --------------------------------------------------------------------------
 * Test steps
 * -------------------------------------------------------------------------- */

static void step_static_on_off(void)
{
	LOG_INF("=== T1: Static ON/OFF (each LED) ===");
	for (uint8_t i = 0; i < CONFIG_ZEGO_LED_NUM_LEDS; i++) {
		LOG_INF("  LED%d ON", i);
		led_cmd(i, LED_COMMAND_ON, 0);
		k_sleep(K_MSEC(600));
		led_cmd(i, LED_COMMAND_OFF, 0);
		k_sleep(K_MSEC(300));
	}
}

static void step_toggle(void)
{
	LOG_INF("=== T2: TOGGLE (LED 0, 4x) ===");
	for (int i = 0; i < 4; i++) {
		led_cmd(0, LED_COMMAND_TOGGLE, 0);
		k_sleep(K_MSEC(400));
	}
	led_cmd(0, LED_COMMAND_OFF, 0);
}

static void step_blink(void)
{
	LOG_INF("=== T3: BLINK -- LED 0, half-period=%d ms ===", CONFIG_ZEGO_LED_BLINK_PERIOD_MS);
	led_cmd(0, LED_COMMAND_BLINK, 0);
	k_sleep(K_SECONDS(4));
	led_cmd(0, LED_COMMAND_OFF, 0);
	k_sleep(K_MSEC(300));
}

static void step_breathe(void)
{
	LOG_INF("=== T4: BREATHE -- LED 0, ramp=%d ms/dir, pwm=%d ms/step ===",
		CONFIG_ZEGO_LED_BREATHE_PERIOD_MS, CONFIG_ZEGO_LED_BREATHE_PWM_PERIOD_MS);
	led_cmd(0, LED_COMMAND_BREATHE, 0);
	/* One full up+down cycle = 2 * ramp period */
	k_sleep(K_MSEC((uint32_t)CONFIG_ZEGO_LED_BREATHE_PERIOD_MS * 2));
	led_cmd(0, LED_COMMAND_OFF, 0);
	k_sleep(K_MSEC(300));
}

static void step_marquee(void)
{
	LOG_INF("=== T5: MARQUEE -- all LEDs, %d ms/step ===", CONFIG_ZEGO_LED_MARQUEE_PERIOD_MS);
	led_cmd(0, LED_COMMAND_MARQUEE, 0);
	k_sleep(K_MSEC((uint32_t)CONFIG_ZEGO_LED_MARQUEE_PERIOD_MS * CONFIG_ZEGO_LED_NUM_LEDS * 3));
	all_off();
	k_sleep(K_MSEC(300));
}

#if defined(CONFIG_ZEGO_LED_USE_PWM)
/*
 * T6 — HW PWM breathe.
 *
 * Breathes each LED in turn.  For LEDs with CONFIG_ZEGO_LED_n_PWM_INDEX >= 0
 * the module uses hardware PWM (true analogue dimming); for others it falls
 * back to software PWM (rapid toggling).  The module log line says
 * "(HW PWM)" or "(SW PWM)" for each LED so you can confirm which path ran.
 *
 * Requires building with:
 *   CONFIG_ZEGO_LED_BACKEND_ZEPHYR=y
 *   CONFIG_ZEGO_LED_USE_PWM=y
 *   CONFIG_ZEGO_LED_n_PWM_INDEX=<pwm-leds child index>  (for each LED with HW PWM)
 */
static void step_breathe_hw_pwm(void)
{
	LOG_INF("=== T6: BREATHE (HW PWM) -- each LED, ramp=%d ms/dir ===",
		CONFIG_ZEGO_LED_BREATHE_PERIOD_MS);
	LOG_INF("    Module log: '(HW PWM)' = hardware PWM path");
	LOG_INF("                '(SW PWM)' = software PWM fallback");

	for (uint8_t i = 0; i < CONFIG_ZEGO_LED_NUM_LEDS; i++) {
		LOG_INF("  LED%d BREATHE", i);
		led_cmd(i, LED_COMMAND_BREATHE, 0);
		k_sleep(K_MSEC((uint32_t)CONFIG_ZEGO_LED_BREATHE_PERIOD_MS * 2));
		led_cmd(i, LED_COMMAND_OFF, 0);
		k_sleep(K_MSEC(300));
	}
}
#endif

/* --------------------------------------------------------------------------
 * Entry point
 * -------------------------------------------------------------------------- */

int main(void)
{
	LOG_INF("==========================================");
	LOG_INF("  Zego LED Sample -- Hardware Test");
	LOG_INF("==========================================");
	LOG_INF("  LEDs              : %d  (NUM_LEDS)", CONFIG_ZEGO_LED_NUM_LEDS);
	LOG_INF("  Blink half-period : %d ms", CONFIG_ZEGO_LED_BLINK_PERIOD_MS);
	LOG_INF("  Breathe period    : %d ms/dir  pwm=%d ms/step",
		CONFIG_ZEGO_LED_BREATHE_PERIOD_MS, CONFIG_ZEGO_LED_BREATHE_PWM_PERIOD_MS);
	LOG_INF("  Marquee step      : %d ms  (MARQUEE_PERIOD_MS)",
		CONFIG_ZEGO_LED_MARQUEE_PERIOD_MS);
#if defined(CONFIG_ZEGO_LED_USE_PWM)
	LOG_INF("  HW PWM breathe    : enabled  (T6 will run)");
#else
	LOG_INF("  HW PWM breathe    : disabled (T6 skipped; all breathe = SW PWM)");
#endif
	LOG_INF("------------------------------------------");
	LOG_INF("  nRF7002DK  : LED1=idx0  LED2=idx1");
	LOG_INF("  nRF54LM20DK: LED0=idx0 ... LED3=idx3");
	LOG_INF("==========================================");

	while (true) {
		step_static_on_off();
		step_toggle();
		step_blink();
		step_breathe();
		step_marquee();
#if defined(CONFIG_ZEGO_LED_USE_PWM)
		step_breathe_hw_pwm();
#endif
		LOG_INF("--- sequence complete, restarting in 2 s ---");
		all_off();
		k_sleep(K_SECONDS(2));
	}

	return 0;
}
```
