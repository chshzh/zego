## led/Kconfig
```kconfig
#
# Copyright (c) 2026 Nordic Semiconductor ASA
# SPDX-License-Identifier: LicenseRef-Nordic-5-Clause
#

config ZEGO_LED
	bool "Zego LED module"
	select DK_LIBRARY
	select ZBUS
	select SMF
	help
	  Enable LED control using an SMF state machine.  Subscribes to
	  LED_CMD_CHAN (zbus) and drives DK LEDs.  Publishes LED_STATE_CHAN after
	  every hardware state change.  The module auto-initializes via SYS_INIT.

	  Publish to LED_CMD_CHAN with struct led_msg to command an LED.
	  See zego/led/docs/led-spec.md for the integration guide.

if ZEGO_LED

config ZEGO_LED_NUM_LEDS
	int "Number of LEDs to control"
	default 4
	range 1 4
	help
	  Number of DK LEDs to manage (0-based indices 0 to N-1).
	  Override this in boards/<board>.conf:
	    nrf7002dk_nrf5340_cpuapp       → 2
	    nrf54lm20dk_nrf54lm20a_cpuapp  → 4

config ZEGO_LED_INIT_PRIORITY
	int "Initialization priority (SYS_INIT APPLICATION level)"
	default 91
	help
	  SYS_INIT priority for the LED module.  Must be greater than the DK
	  library's own init priority.  Set higher than ZEGO_BUTTON_INIT_PRIORITY
	  if both modules are enabled.

config ZEGO_LED_BLINK_PERIOD_MS
	int "Default blink half-period in milliseconds"
	default 250
	range 50 10000
	help
	  Time the LED stays on (and off) for each blink half-cycle when
	  LED_COMMAND_BLINK is sent with period_ms = 0.  Full cycle = 2x this value.

config ZEGO_LED_BREATHE_PERIOD_MS
	int "Breathe ramp duration per direction in milliseconds"
	default 3000
	range 200 30000
	help
	  Time for one ramp direction (fade-up or fade-down) when
	  LED_COMMAND_BREATHE is sent with period_ms = 0.
	  Full cycle = 2 × this value (default: 3 s up + 3 s down = 6 s total).
	  Number of PWM steps = this value / CONFIG_ZEGO_LED_BREATHE_PWM_PERIOD_MS.

config ZEGO_LED_BREATHE_PWM_PERIOD_MS
	int "Breathe software-PWM frame duration in milliseconds"
	default 20
	range 5 100
	help
	  Duration of one software-PWM cycle used by the breathe effect.
	  The duty cycle steps linearly across CONFIG_ZEGO_LED_BREATHE_PERIOD_MS /
	  this value steps per ramp direction.  Lower values give finer brightness
	  resolution; higher values reduce CPU wake-ups but produce a coarser step.
	  Default 20 ms (50 Hz) gives 150 steps per 3 s ramp.

config ZEGO_LED_MARQUEE_PERIOD_MS
	int "Default marquee step period in milliseconds"
	default 500
	range 50 5000
	help
	  Time each LED stays lit during the marquee sweep when
	  LED_COMMAND_MARQUEE is sent with period_ms = 0.

module = ZEGO_LED
module-str = zego_led
source "subsys/logging/Kconfig.template.log_config"

endif # ZEGO_LED
```

## led/boards/nrf54lm20dk_nrf54lm20a_cpuapp.conf
```kconfig
# nRF54L-M20 DK — 4 user LEDs (LED0..LED3, indices 0..3)
CONFIG_ZEGO_LED_NUM_LEDS=4
CONFIG_ZEGO_LED_BACKEND_DK=y
# To use the Zephyr LED driver backend (required for hardware-PWM breathe):
#   CONFIG_ZEGO_LED_BACKEND_ZEPHYR=y
#   CONFIG_ZEGO_LED_USE_PWM=y
#   CONFIG_ZEGO_LED_0_PWM_INDEX=-1  # LED0 → GPIO only, software PWM fallback
#   CONFIG_ZEGO_LED_1_PWM_INDEX=0   # LED1 → pwm-leds child index 0 (pwm_led_1)
#   CONFIG_ZEGO_LED_2_PWM_INDEX=-1  # LED2 → GPIO only
#   CONFIG_ZEGO_LED_3_PWM_INDEX=-1  # LED3 → GPIO only
```

## led/boards/nrf7002dk_nrf5340_cpuapp.conf
```kconfig
# nRF7002 DK — 2 user LEDs (LED1 = index 0, LED2 = index 1)
CONFIG_ZEGO_LED_NUM_LEDS=2
```

## led/test/testcase.yaml
```yaml
tests:
  zego.led.unit:
    tags: zego led ztest
    platform_allow: native_sim
    integration_platforms:
      - native_sim
```

## modules/Kconfig
```kconfig
#
# Copyright (c) 2026 Nordic Semiconductor ASA
# SPDX-License-Identifier: LicenseRef-Nordic-5-Clause
#
# Zego shared modules — root Kconfig.
# Source this from each application's Kconfig:
#
#   osource "$(ZEGO_MODULES_DIR)/Kconfig"
#
# The ZEGO_MODULES_DIR CMake variable is converted by west to a Kconfig
# environment variable automatically when set in CMakeLists.txt.
#

menu "Zego shared modules"

rsource "button/Kconfig.zego_button"
rsource "network/Kconfig.zego_network"
rsource "led/Kconfig.zego_led"

endmenu # Zego shared modules
```

## modules/button/Kconfig
```kconfig
#
# Copyright (c) 2026 Nordic Semiconductor ASA
# SPDX-License-Identifier: LicenseRef-Nordic-5-Clause
#

config ZEGO_BUTTON
	bool "Zego button module"
	select ZBUS
	select SMF
	help
	  Enable debounced button monitoring using an SMF state machine.
	  Publishes BUTTON_PRESSED / BUTTON_RELEASED raw events and classified
	  gesture events (BUTTON_SINGLE_CLICK, BUTTON_DOUBLE_CLICK,
	  BUTTON_LONG_PRESS) on BUTTON_CHAN (zbus).  Auto-initializes via SYS_INIT.

	  Include <zego/button.h> and use ZBUS_CHAN_ADD_OBS(BUTTON_CHAN, ...) to
	  subscribe.  See zego/button/docs/button-spec.md for the integration guide.

	  Select a hardware backend below (ZEGO_BUTTON_BACKEND_DK or _GPIO).

if ZEGO_BUTTON

# ---------------------------------------------------------------------------
# Hardware backend
# ---------------------------------------------------------------------------

choice ZEGO_BUTTON_BACKEND
	prompt "Button hardware backend"
	default ZEGO_BUTTON_BACKEND_DK
	help
	  Select how the button module reads physical button state.

config ZEGO_BUTTON_BACKEND_DK
	bool "Nordic DK library (dk_buttons_and_leds)"
	select DK_LIBRARY
	help
	  Use the Nordic DK convenience library callback.  Works out-of-the-box
	  on nRF7002DK and nRF54LM20DK.  Default for all supported boards.

config ZEGO_BUTTON_BACKEND_GPIO
	bool "Zephyr Input subsystem (gpio-keys)"
	select INPUT
	help
	  Use the Zephyr Input subsystem.  Translates INPUT_EV_KEY events from
	  the gpio-keys driver into the internal bitmask format.  Requires
	  consecutive linux,code values starting from 0 on the board's gpio-keys
	  DTS nodes — add a board overlay in zego/button/boards/ if needed.
	  Portable to any board with a gpio-keys DTS node.

endchoice # ZEGO_BUTTON_BACKEND

config ZEGO_BUTTON_NUM_BUTTONS
	int "Number of buttons to monitor"
	default 4
	range 1 4
	help
	  Number of DK buttons to monitor (0-based indices 0 to N-1).
	  Override this in boards/<board>.conf:
	    nrf7002dk_nrf5340_cpuapp           → 2
	    nrf54lm20dk_nrf54lm20a_cpuapp      → 4 (or 3 when -DSHIELD=nrf7002eb2,
	                                           set by the application board conf)

config ZEGO_BUTTON_LONG_PRESS_MS
	int "Long-press threshold (ms)"
	default 3000
	help
	  Press duration (ms) at which a BUTTON_LONG_PRESS event is published.
	  The event fires while the button is still held.

config ZEGO_BUTTON_DOUBLE_CLICK_WINDOW_MS
	int "Double-click detection window (ms)"
	default 400
	help
	  Maximum interval between two presses to detect a BUTTON_DOUBLE_CLICK.
	  After a press+release the module waits this long for a 2nd press.
	  If none arrives, BUTTON_SINGLE_CLICK is published instead.

config ZEGO_BUTTON_INIT_PRIORITY
	int "Initialization priority (SYS_INIT APPLICATION level)"
	default 90
	help
	  SYS_INIT priority for the button module.  Must be greater than the DK
	  library's own init priority.

module = ZEGO_BUTTON
module-str = zego_button
source "subsys/logging/Kconfig.template.log_config"

endif # ZEGO_BUTTON
```

## modules/button/Kconfig.zego_button
```kconfig
#
# Copyright (c) 2026 Nordic Semiconductor ASA
# SPDX-License-Identifier: LicenseRef-Nordic-5-Clause
#

config ZEGO_BUTTON
	bool "Zego button module"
	depends on DK_LIBRARY
	help
	  Enable the shared Zego button module. Monitors DK buttons and publishes
	  press/release events on the zbus BUTTON_CHAN channel.

if ZEGO_BUTTON

module = ZEGO_BUTTON
module-str = zego_button
source "subsys/logging/Kconfig.template.log_config"

config ZEGO_BUTTON_DEBOUNCE_MS
	int "Debounce time in milliseconds"
	default 50
	help
	  Software debounce window applied to raw button state changes.

endif # ZEGO_BUTTON
```
