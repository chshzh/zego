## bricks/network/Kconfig
```kconfig
#
# Copyright (c) 2026 Nordic Semiconductor ASA
#
# SPDX-License-Identifier: LicenseRef-Nordic-5-Clause
#

config ZEGO_NETWORK
	bool "Shared network/Wi-Fi event management module"
	default n
	depends on ZEGO_WIFI
	select WIFI
	select WIFI_NRF70
	select WIFI_NM_WPA_SUPPLICANT
	select NET_CONNECTION_MANAGER
	select L2_WIFI_CONNECTIVITY
	select NET_IPV4
	select NET_SOCKETS
	select NET_UDP
	select NET_DHCPV4
	select DNS_RESOLVER
	help
	  Shared Zephyr module providing a unified Wi-Fi / network event
	  management layer for zego-based applications.  Handles interface
	  UP/DOWN events, WPA supplicant ready sequencing, SoftAP / P2P
	  bring-up, DHCP server, STA / P2P DHCP binding, and weak callback
	  hooks for app-specific zbus channel publishing.

if ZEGO_NETWORK

# ---------------------------------------------------------------------------
# Transport protocols
# ---------------------------------------------------------------------------

config ZEGO_NETWORK_TCP
	bool "Enable TCP support"
	default y
	select NET_TCP
	help
	  Enables the Zephyr TCP/IP stack (CONFIG_NET_TCP).  Disable for
	  UDP-only applications (e.g. audio streaming) to save flash — the
	  TCP stack costs several KB of code.  Leave enabled for apps that
	  need HTTP(S)/TLS (e.g. cloud uploads, web dashboards).

config ZEGO_NETWORK_WIFI_CREDENTIALS
	bool "Enable persistent Wi-Fi credential storage (wifi_credentials)"
	default y
	select WIFI_CREDENTIALS
	help
	  Enables the Zephyr wifi_credentials subsystem, used by zego/network to
	  persist STA credentials ('wifi cred add') and auto-reconnect via
	  NET_REQUEST_WIFI_CONNECT_STORED on boot, link loss, and (without
	  CONFIG_ZEGO_WIFI_BLE_PROV) the STA reconnect watchdog.

	  Disable to save flash/RAM if the app only needs the plain
	  'wifi connect <ssid> <psk>' shell command for one-off connections -
	  Wi-Fi still comes up, it just is not remembered across reboots and
	  is not auto-retried by zego/network (net_event_mgmt.c falls back to a
	  no-op in this case). Note: CONFIG_ZEGO_WIFI_BLE_PROV depends on
	  WIFI_CREDENTIALS and is force-disabled along with this option.

# ---------------------------------------------------------------------------
# SoftAP / P2P GO configuration
# ---------------------------------------------------------------------------

menu "SoftAP Configuration"

config ZEGO_WIIF_SOFTAP_REG_DOMAIN
	string "SoftAP regulatory domain"
	default "US"
	help
	  Two-letter country code for the regulatory domain used in SoftAP /
	  P2P GO mode (e.g. "US", "EU", "JP").  Use "00" for world mode.

config ZEGO_WIIF_SOFTAP_SSID
	string "SoftAP SSID"
	default "device_AP"
	help
	  SSID used when hosting a SoftAP.  Override per app in prj.conf or
	  an overlay file.  Must not be committed with production credentials.

config ZEGO_WIIF_SOFTAP_PASSWORD
	string "SoftAP password"
	default "password@123"
	help
	  WPA2 password for SoftAP (minimum 8 characters).  Override per app.

choice ZEGO_WIIF_SOFTAP_BAND
	prompt "SoftAP Wi-Fi band"
	default ZEGO_WIIF_SOFTAP_BAND_2_4_GHZ
	help
	  Wi-Fi frequency band to use when hosting SoftAP or P2P GO.

config ZEGO_WIIF_SOFTAP_BAND_2_4_GHZ
	bool "2.4 GHz"

config ZEGO_WIIF_SOFTAP_BAND_5_GHZ
	bool "5 GHz"

endchoice # ZEGO_WIIF_SOFTAP_BAND

config ZEGO_WIIF_SOFTAP_CHANNEL
	int "SoftAP channel"
	default 1
	range 1 196
	help
	  Wi-Fi channel number for SoftAP / P2P GO.  Must be valid for the
	  selected band and regulatory domain.

endmenu # "SoftAP Configuration"

# ---------------------------------------------------------------------------
# P2P GC: no build-time configuration.
# The target GO MAC is learned at runtime via button-triggered WPS PIN pairing
# (wifi_p2p_start_pairing) and persisted in NVS at settings key
# "net/p2p_gc_go_mac".  See bricks/network/docs/network-spec.md.
# ---------------------------------------------------------------------------

# ---------------------------------------------------------------------------
# STA Configuration
# ---------------------------------------------------------------------------

menu "STA Configuration"

config ZEGO_NETWORK_STA_DHCP_TIMEOUT_SEC
	int "STA: DHCP-bound watchdog timeout (s, 0 = disabled)"
	default 30
	help
	  L3 connectivity watchdog for STA mode.  A successful Wi-Fi
	  association (NET_EVENT_WIFI_CONNECT_RESULT) only means the link is up
	  at L2 — it does NOT mean an IP was obtained.  If DHCP never binds
	  (NET_EVENT_IPV4_DHCP_BOUND) within this many seconds of association,
	  or a bound lease is later lost while the link stays associated, the
	  device is stuck "associated but no IP" with no usable connectivity.

	  When this timer expires the module issues NET_REQUEST_WIFI_DISCONNECT,
	  which produces a DISCONNECT_RESULT and re-arms the normal reconnect
	  loop, breaking the device out of the half-connected state instead of
	  waiting for a manual reset.

	  Set to 0 to disable the watchdog.  The default (30 s) is comfortably
	  longer than a healthy DHCP DISCOVER/OFFER/REQUEST/ACK cycle.

endmenu # "STA Configuration"

# ---------------------------------------------------------------------------
# mDNS / DNS-SD
# ---------------------------------------------------------------------------

config ZEGO_NETWORK_MDNS
	bool "Enable mDNS hostname advertisement"
	default n
	select NET_HOSTNAME_ENABLE
	select MDNS_RESPONDER
	select DNS_SD
	help
	  Enables the Zephyr mDNS responder so the device is reachable as
	  <hostname>.local on any active Wi-Fi interface (SoftAP, STA,
	  P2P_GO, P2P_GC). No application code required — enabling this
	  option and setting CONFIG_NET_HOSTNAME in prj.conf is sufficient.

	  Mode notes:
	    SoftAP / P2P_GO  — works immediately; device IP is 192.168.7.1
	    STA              — works after DHCP; requires router to pass mDNS
	                       multicast (home routers usually do)
	    P2P_GC           — advertised but phone-as-GO rarely forwards mDNS
	                       multicast; direct IP is the reliable fallback

	  The hostname is taken from CONFIG_NET_HOSTNAME.  When this option is
	  enabled the default hostname is "zego-device" (→ zego-device.local).
	  Override in prj.conf:  CONFIG_NET_HOSTNAME="myapp"

if ZEGO_NETWORK_MDNS

config ZEGO_NETWORK_MDNS_HTTP_PORT
	int "DNS-SD HTTP service port (0 = disabled)"
	default 0
	range 0 65535
	help
	  When non-zero, registers an _http._tcp.local DNS-SD service record
	  at this port.  This allows service-discovery browsers (Bonjour,
	  Avahi, iOS Safari, Android Chrome) to find the HTTP server without
	  knowing the device IP address.

	  Set to 80 (or CONFIG_APP_HTTP_PORT) to match the HTTP server port.
	  Leave at 0 if the device does not run an HTTP server, or if only
	  hostname resolution (hostname.local) is needed.

endif # ZEGO_NETWORK_MDNS

# ---------------------------------------------------------------------------
# Log level (standard Zephyr template)
# ---------------------------------------------------------------------------

module = ZEGO_NETWORK
module-str = zego_network
source "subsys/logging/Kconfig.template.log_config"

endif # ZEGO_NETWORK
```

## bricks/network/Kconfig.defaults
```kconfig
#
# Copyright (c) 2026 Nordic Semiconductor ASA
#
# SPDX-License-Identifier: LicenseRef-Nordic-5-Clause
#
# Default values for the network / WiFi infrastructure module.
# Override in prj.conf as needed.
# Note: choice symbols (log levels) cannot be set here; use prj.conf.
#

# ---------------------------------------------------------------------------
# WiFi driver (nRF70)
# ---------------------------------------------------------------------------
# WIFI / WIFI_NRF70: selected unconditionally by ZEGO_NETWORK (see Kconfig).

# ---------------------------------------------------------------------------
# WPA supplicant
# ---------------------------------------------------------------------------
# WIFI_NM_WPA_SUPPLICANT: selected unconditionally by ZEGO_NETWORK (see Kconfig).

config WIFI_NM_WPA_SUPPLICANT_THREAD_STACK_SIZE
	default 8192 if ZEGO_NETWORK

config WIFI_NM_WPA_SUPPLICANT_WQ_STACK_SIZE
	default 5632 if ZEGO_NETWORK

# ---------------------------------------------------------------------------
# nRF70 driver settings
# ---------------------------------------------------------------------------
config NRF_WIFI_SCAN_MAX_BSS_CNT
	default 20 if ZEGO_NETWORK

config NRF_WIFI_CTRL_HEAP_SIZE
	default 20000 if ZEGO_NETWORK

config NRF_WIFI_DATA_HEAP_SIZE
	default 54856 if ZEGO_NETWORK

config NRF70_RX_NUM_BUFS
	default 16 if ZEGO_NETWORK

config NRF70_MAX_TX_AGGREGATION
	default 4 if ZEGO_NETWORK

# ---------------------------------------------------------------------------
# WiFi / BLE coexistence
# ---------------------------------------------------------------------------
config NRF70_SR_COEX
	default y if ZEGO_NETWORK

config NRF70_SR_COEX_RF_SWITCH
	default y if ZEGO_NETWORK && NRF70_SR_COEX

# ---------------------------------------------------------------------------
# L2 WiFi connectivity (connection manager)
# ---------------------------------------------------------------------------
# NET_CONNECTION_MANAGER / L2_WIFI_CONNECTIVITY: selected unconditionally by
# ZEGO_NETWORK (see Kconfig).

# HWM 4572 B (88% of 5168!) x 1.5 = 6858 -> 7168 -- INCREASED for safety
config NET_CONNECTION_MANAGER_MONITOR_STACK_SIZE
	default 7168 if ZEGO_NETWORK

config L2_WIFI_CONNECTIVITY_AUTO_CONNECT
	default y if ZEGO_NETWORK

config L2_WIFI_CONNECTIVITY_AUTO_DOWN
	default n

# ---------------------------------------------------------------------------
# WiFi credentials (persistent storage via ZMS)
# ---------------------------------------------------------------------------
# WIFI_CREDENTIALS: selected by CONFIG_ZEGO_NETWORK_WIFI_CREDENTIALS (see
# Kconfig), default y. Set CONFIG_ZEGO_NETWORK_WIFI_CREDENTIALS=n in prj.conf
# to disable it (also disables CONFIG_ZEGO_WIFI_BLE_PROV, which depends on it).
# WIFI_CREDENTIALS_BACKEND_SETTINGS is a choice symbol - set in prj.conf.

# ---------------------------------------------------------------------------
# Network stack
# ---------------------------------------------------------------------------
config NETWORKING
	default y if ZEGO_NETWORK

# NET_IPV4 / NET_UDP / NET_TCP / NET_DHCPV4: selected unconditionally by
# ZEGO_NETWORK (see Kconfig).

config NET_IPV6
	default n

config NET_TCP_TIME_WAIT_DELAY
	default 1000 if ZEGO_NETWORK

# ---------------------------------------------------------------------------
# Network buffers
# ---------------------------------------------------------------------------
config NET_PKT_RX_COUNT
	default 8 if ZEGO_NETWORK

config NET_PKT_TX_COUNT
	default 8 if ZEGO_NETWORK

config NET_BUF_RX_COUNT
	default 16 if ZEGO_NETWORK

config NET_BUF_TX_COUNT
	default 64 if ZEGO_NETWORK

# NET_BUF_FIXED_DATA_SIZE is a choice symbol - set in prj.conf.

config NET_BUF_DATA_SIZE
	default 128 if ZEGO_NETWORK

config NET_TC_TX_COUNT
	default 1 if ZEGO_NETWORK

# ---------------------------------------------------------------------------
# Network interface
# ---------------------------------------------------------------------------
config NET_IF_UNICAST_IPV4_ADDR_COUNT
	default 1 if ZEGO_NETWORK

config NET_MAX_CONTEXTS
	default 10 if ZEGO_NETWORK

config NET_MAX_CONN
	default 10 if ZEGO_NETWORK

# ---------------------------------------------------------------------------
# Sockets
# ---------------------------------------------------------------------------
# NET_SOCKETS: selected unconditionally by ZEGO_NETWORK (see Kconfig).

config NET_SOCKETS_POLL_MAX
	default 20 if ZEGO_NETWORK

# ---------------------------------------------------------------------------
# DNS resolution
# Allow concurrent lookups from https_client, mqtt_client, memfault, etc.
# ---------------------------------------------------------------------------
# DNS_RESOLVER: selected unconditionally by ZEGO_NETWORK (see Kconfig).

config DNS_RESOLVER_ADDITIONAL_BUF_CTR
	default 2 if ZEGO_NETWORK

config DNS_RESOLVER_ADDITIONAL_QUERIES
	default 2 if ZEGO_NETWORK

# ---------------------------------------------------------------------------
# Net management event queue
# ---------------------------------------------------------------------------
config NET_MGMT_EVENT_QUEUE_SIZE
	default 150 if ZEGO_NETWORK

# HWM 2580 B (22% of 12000) x 2.0 = 5160 -> 6144 -- halved with 2x safety margin
config NET_MGMT_EVENT_STACK_SIZE
	default 6144 if ZEGO_NETWORK

config NET_MGMT_EVENT_QUEUE_TIMEOUT
	default 5000 if ZEGO_NETWORK

# ---------------------------------------------------------------------------
# mDNS hostname defaults
# ---------------------------------------------------------------------------
# Override the Zephyr default ("zephyr") with a sensible brick default when
# mDNS is enabled.  The app can still override with CONFIG_NET_HOSTNAME="myapp"
# in prj.conf — that explicit setting takes precedence over any default.
config NET_HOSTNAME
	default "zego-device" if ZEGO_NETWORK_MDNS

# Disable MAC-suffix uniquification so the hostname stays predictable.
# Flip to y in prj.conf if multiple devices share the same network.
config NET_HOSTNAME_UNIQUE
	default n if ZEGO_NETWORK_MDNS
```

## bricks/ntp/Kconfig
```kconfig
#
# Copyright (c) 2026 Nordic Semiconductor ASA
#
# SPDX-License-Identifier: LicenseRef-Nordic-5-Clause
#

config ZEGO_NTP
	bool "NTP time synchronization"
	select SNTP
	depends on ZBUS && NETWORKING
	default n
	help
	  Queries an SNTP server and sets CLOCK_REALTIME once network
	  connectivity is established. When CONFIG_LOG_TIMESTAMP_USE_REALTIME=y
	  is also set, Zephyr log output shows real-world wall-clock timestamps.

	  The module has no zbus channel of its own; instead it declares
	  ZEGO_NTP_NET_CHAN, which the application publishes to - typically
	  from its zego/network weak-hook overrides (net_event_app.c) -
	  following the same decoupling pattern used by zego/ux.

if ZEGO_NTP

config ZEGO_NTP_SERVER
	string "SNTP server hostname"
	default "pool.ntp.org"
	help
	  Hostname of the SNTP server used for time synchronization.

config ZEGO_NTP_TIMEOUT_MS
	int "SNTP query timeout (ms)"
	default 5000
	range 1000 30000
	help
	  Maximum time to wait for an SNTP response, in milliseconds.

config ZEGO_NTP_RETRY_INTERVAL_SEC
	int "Retry interval on failure (s)"
	default 30
	range 5 3600
	help
	  How long to wait before retrying a failed SNTP query.

config ZEGO_NTP_RESYNC_INTERVAL_SEC
	int "Periodic re-sync interval after a successful sync (s)"
	default 10800
	range 60 86400
	help
	  How often to re-sync after a successful query to compensate for
	  crystal oscillator drift. At 40 ppm, the clock drifts ~0.5 s over
	  ~3.5 hours, so the default of 10800 s (3 h) keeps drift under 0.5 s.
	  Set to 0 to disable periodic re-sync (sync once per connection only).

module = ZEGO_NTP
module-str = zego_ntp
source "subsys/logging/Kconfig.template.log_config"

endif # ZEGO_NTP
```
