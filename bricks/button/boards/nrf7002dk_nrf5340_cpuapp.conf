## bricks/wifi/Kconfig
```kconfig
#
# Copyright (c) 2026 Nordic Semiconductor ASA
# SPDX-License-Identifier: LicenseRef-Nordic-5-Clause
#

config ZEGO_WIFI
        bool "Zego Wi-Fi module (mode selector)"
        select NETWORKING
        select ZBUS
        help
          Provides:
            - WIFI_MODE_CHAN: zbus channel published at SYS_INIT APPLICATION priority 0.
            - zego_wifi_get_mode(): returns the active Wi-Fi mode.
          When NRF70_AP_MODE or NRF70_P2P_MODE is enabled, ZEGO_WIFI_MODE_SELECTOR
          is auto-enabled to persist the active mode in NVS.  STA-only builds skip
          NVS entirely — WIFI_MODE_CHAN is published as STA directly from wifi.c.
          The startup banner previously provided here now lives in zego/bricks/ux
          — see zego_ux_print_banner() (CONFIG_ZEGO_UX).

config ZEGO_WIFI_MODE_SELECTOR
	bool
	depends on ZEGO_WIFI
	default y if NRF70_AP_MODE || NRF70_P2P_MODE
	select SETTINGS
	select FLASH
	select FLASH_MAP
	select FLASH_PAGE_LAYOUT
	select REBOOT
	help
	  Automatically enabled when more than one Wi-Fi mode is available
	  (NRF70_AP_MODE or NRF70_P2P_MODE).  Stores the active mode as a
	  uint8_t in NVS under "app/zego_wifi_mode" and registers the
	  'zego_wifi_mode' shell command.  Changing the enum order in wifi.h
	  without erasing NVS will corrupt the stored value.
	  When disabled (STA-only builds) no NVS or settings access occurs.

if ZEGO_WIFI

if ZEGO_WIFI_MODE_SELECTOR

choice ZEGO_WIFI_DEFAULT_MODE
	prompt "Default Wi-Fi mode on fresh flash (no NVS key present)"
	# Pick the fresh-flash default from the modes this build actually exposes,
	# so a role overlay only needs to set ZEGO_WIFI_MODE_*_ENABLED (not the
	# default too).  STA is the final fallback (always enabled). Ordering: a
	# build with exactly one P2P role enabled defaults to it; a build with both
	# (or neither) falls through to STA.
	default ZEGO_WIFI_DEFAULT_MODE_P2P_GO if ZEGO_WIFI_MODE_P2P_GO_ENABLED && !ZEGO_WIFI_MODE_P2P_GC_ENABLED
	default ZEGO_WIFI_DEFAULT_MODE_P2P_GC if ZEGO_WIFI_MODE_P2P_GC_ENABLED && !ZEGO_WIFI_MODE_P2P_GO_ENABLED
	default ZEGO_WIFI_DEFAULT_MODE_STA
	help
	  Selects the mode used when NVS has no stored value (e.g. first boot
	  after --erase).  The 'zego_wifi_mode' shell command can change it at
	  any time; the board reboots to apply the change.

config ZEGO_WIFI_DEFAULT_MODE_STA
	bool "STA — join an existing Wi-Fi network"

config ZEGO_WIFI_DEFAULT_MODE_SOFTAP
	bool "SoftAP — create an access point"
	depends on ZEGO_WIFI_MODE_SOFTAP_ENABLED

config ZEGO_WIFI_DEFAULT_MODE_P2P_GO
	bool "P2P Group Owner (Wi-Fi Direct)"
	depends on ZEGO_WIFI_MODE_P2P_GO_ENABLED

config ZEGO_WIFI_DEFAULT_MODE_P2P_GC
	bool "P2P GC — join a peer's P2P group as Group Client"
	depends on ZEGO_WIFI_MODE_P2P_GC_ENABLED

endchoice

endif # ZEGO_WIFI_MODE_SELECTOR

config ZEGO_WIFI_MODE_STA_ENABLED
	bool "Expose STA as a user-selectable Wi-Fi mode"
	default y
	help
	  When y, STA mode is compiled in and listed in the boot banner and
	  zego_wifi_mode shell command. Disable only for builds that must not
	  expose STA to the user (e.g. kiosk P2P-only builds).

config ZEGO_WIFI_MODE_P2P_GO_ENABLED
	bool "Expose P2P_GO as a user-selectable Wi-Fi mode"
	depends on NRF70_P2P_MODE
	default y if NRF70_P2P_MODE
	help
	  When y, the P2P_GO mode is compiled in and listed in the boot banner
	  and zego_wifi_mode shell command. Defaults y when NRF70_P2P_MODE is set.

config ZEGO_WIFI_MODE_P2P_GC_ENABLED
	bool "Expose P2P_GC (Group Client) as a user-selectable Wi-Fi mode"
	depends on NRF70_P2P_MODE
	default y if NRF70_P2P_MODE
	help
	  When y, the P2P_GC (Group Client) mode is compiled in and listed in
	  the boot banner and zego_wifi_mode shell command. Defaults y when
	  NRF70_P2P_MODE is set.

config ZEGO_WIFI_MODE_SOFTAP_ENABLED
	bool "Expose SoftAP as a user-selectable Wi-Fi mode"
	depends on NRF70_AP_MODE
	default y if NRF70_AP_MODE && !NRF70_P2P_MODE
	help
	  When y, the 'zego_wifi_mode softap' shell command and its help text are
	  compiled in, and the boot banner lists softap as a switchable mode.

	  Defaults to y only when NRF70_AP_MODE is set without NRF70_P2P_MODE,
	  because P2P mode internally requires NRF70_AP_MODE for its GO path but
	  does not expose standalone SoftAP to the user.  Enable explicitly in an
	  overlay when you want both P2P and SoftAP available simultaneously.

config ZEGO_APP_PRD_VERSION
	string "PRD version this firmware was implemented against"
	default "unknown"
	help
	  Set to the PRD Changelog timestamp (YYYY-MM-DD-HH-MM) of the PRD version
	  used when writing this firmware.  Updated by the developer in prj.conf
	  whenever the implementation is synced to a new PRD revision.
	  Printed in the boot banner as "PRD: <version>".

config ZEGO_APP_SPECS_VERSION
	string "Specs version this firmware was implemented against"
	default "unknown"
	help
	  Set to the Specs Changelog timestamp (YYYY-MM-DD-HH-MM) of the
	  overview.md version used when writing this firmware.  Updated by the
	  developer in prj.conf whenever the implementation is synced to a new
	  specs revision.  Printed in the boot banner as "Specs: <version>".

module = ZEGO_WIFI
module-str = zego_wifi
source "${ZEPHYR_BASE}/subsys/logging/Kconfig.template.log_config"

endif # ZEGO_WIFI
```

## bricks/wifi_ble_prov/Kconfig
```kconfig
#
# Copyright (c) 2026 Nordic Semiconductor ASA
# SPDX-License-Identifier: LicenseRef-Nordic-5-Clause
#

config ZEGO_WIFI_BLE_PROV
	bool "Zego Wi-Fi BLE provisioning module"
	depends on ZEGO_NETWORK && ZBUS && WIFI_CREDENTIALS
	select BT
	select BT_PERIPHERAL
	select BT_SMP
	select BT_WIFI_PROV
	select WIFI_PROV_CORE
	select NANOPB
	select REBOOT
	help
	  BLE-based Wi-Fi credential provisioning using the nRF Wi-Fi Provisioner
	  app (Android / iOS).

	  Provides:
	    - WIFI_CHAN (struct wifi_msg): zbus channel for Wi-Fi connect/disconnect.
	      The app's net_event_app.c must declare and publish to this channel.
	    - SYS_INIT APPLICATION priority 95: BT init + Wi-Fi provisioning service.
	    - Automatic credential-based reconnect after provisioning.
	    - Rotating retry across all stored networks on disconnect.
	    - DHCP-bind watchdog that reboots to recover from a known
	      wifi_prov_core disconnect+connect race (see
	      CONFIG_ZEGO_WIFI_BLE_PROV_DHCP_WATCHDOG_SEC).

	  Enable in prj.conf:  CONFIG_ZEGO_WIFI_BLE_PROV=y

if ZEGO_WIFI_BLE_PROV

config ZEGO_WIFI_BLE_PROV_ADV_DAEMON_STACK_SIZE
	int "BLE advertising daemon work queue stack size (bytes)"
	default 4096
	help
	  Stack size for the ble_adv_daemon_wq work queue thread that drives
	  BLE advertising parameter and data updates during Wi-Fi provisioning.

config ZEGO_WIFI_BLE_PROV_DHCP_WATCHDOG_SEC
	int "Reboot if DHCP doesn't bind within N seconds of a connect (0 = disabled)"
	default 25
	range 0 300
	help
	  Nordic's wifi_prov_core library issues NET_REQUEST_WIFI_DISCONNECT
	  immediately followed by NET_REQUEST_WIFI_CONNECT when new Wi-Fi
	  credentials are provisioned over BLE, with no wait for the
	  disconnect to actually complete.  On some nRF70 + host combinations
	  this wedges wpa_supplicant's control interface: the interface
	  reports STA associated (wifi status / CONNECT_RESULT) but the
	  control-socket transport itself is jammed, so DHCP never binds and
	  no further Wi-Fi command (disconnect/connect/status) can recover it
	  - only a reboot clears the wedge.

	  When this watchdog fires (DHCP still unbound N seconds after a
	  Wi-Fi connect observed by this module), the device performs a warm
	  reboot to recover.  Set to 0 to disable.

config ZEGO_WIFI_BLE_PROV_RECONNECT_DELAY_SEC
	int "Delay before the first reconnect attempt after a disconnect (seconds)"
	default 5
	range 1 300
	help
	  How long to wait after a disconnect before the first
	  connect_stored_rotating() attempt.

config ZEGO_WIFI_BLE_PROV_RECONNECT_RETRY_SEC
	int "Interval between rotating-credential reconnect attempts (seconds)"
	default 60
	range 5 600
	help
	  Interval between successive connect_stored_rotating() attempts while
	  still disconnected. Each attempt tries the next stored credential in
	  rotation, so with N stored credentials the worst-case time to reach
	  the one that is actually in range is roughly
	  ZEGO_WIFI_BLE_PROV_RECONNECT_DELAY_SEC + (N-1) * this value.

	  The 60 s default balances avoiding excessive AP/scan traffic against
	  reasonably fast failover across stored networks. Lower it further if
	  faster multi-AP failover matters more than minimizing retry traffic
	  - a single connect attempt (scan + auth + failure/timeout) typically
	  resolves within 15-20 s, so values much below that risk overlapping
	  the next rotation with an attempt still in flight.

module = ZEGO_WIFI_BLE_PROV
module-str = zego_wifi_ble_prov
source "${ZEPHYR_BASE}/subsys/logging/Kconfig.template.log_config"

endif # ZEGO_WIFI_BLE_PROV

rsource "Kconfig.defaults"
```

## bricks/wifi_ble_prov/Kconfig.defaults
```kconfig
#
# Copyright (c) 2026 Nordic Semiconductor ASA
# SPDX-License-Identifier: LicenseRef-Nordic-5-Clause
#
# Default values for BLE stack tuning when ZEGO_WIFI_BLE_PROV is enabled.
# Override in prj.conf as needed.
# Note: choice symbols (log levels) cannot be set here; use prj.conf.
#

# Do not store BLE bonds; provisioning app re-pairs each session.
config BT_BONDABLE
	default n if ZEGO_WIFI_BLE_PROV

config BT_DEVICE_NAME_DYNAMIC
	default y if ZEGO_WIFI_BLE_PROV

# BT buffer sizes tuned for the nRF Wi-Fi Provisioner MTU (147 bytes L2CAP).
config BT_BUF_ACL_RX_SIZE
	default 151 if ZEGO_WIFI_BLE_PROV

config BT_L2CAP_TX_MTU
	default 147 if ZEGO_WIFI_BLE_PROV

config BT_BUF_ACL_TX_SIZE
	default 151 if ZEGO_WIFI_BLE_PROV

# CRITICAL: BLE and WiFi share the same BT RX workqueue during provisioning.
# 22000 bytes required to handle concurrent WiFi scan + BLE traffic.
# Do NOT reduce: the nRF5340 RAM budget is tight and lower values cause
# OOM panics during SMP pairing.
config BT_RX_STACK_SIZE
	default 22000 if ZEGO_WIFI_BLE_PROV

# 75 units (750 ms) - avoids supervision timeout during WiFi scan delays.
config BT_PERIPHERAL_PREF_TIMEOUT
	default 75 if ZEGO_WIFI_BLE_PROV
```

## button/Kconfig
```kconfig
#
# Copyright (c) 2026 Nordic Semiconductor ASA
# SPDX-License-Identifier: LicenseRef-Nordic-5-Clause
#

config ZEGO_BUTTON
	bool "Zego button module"
	select ZBUS
	select SMF
	help
	  Enable debounced button monitoring using an SMF state machine.
	  Monitors buttons and publishes gesture events on BUTTON_CHAN (zbus).
	  The module auto-initializes via SYS_INIT.

	  Include <zego/button.h> and use ZBUS_CHAN_ADD_OBS(BUTTON_CHAN, ...) to
	  subscribe.  See zego/button/docs/button-spec.md for the integration guide.

	  Select a hardware backend below (ZEGO_BUTTON_BACKEND_DK or _GPIO).

if ZEGO_BUTTON

# ---------------------------------------------------------------------------
# Hardware backend
# ---------------------------------------------------------------------------

choice ZEGO_BUTTON_BACKEND
	prompt "Button hardware backend"
	default ZEGO_BUTTON_BACKEND_DK
	help
	  Select how the button module reads physical button state.

config ZEGO_BUTTON_BACKEND_DK
	bool "Nordic DK library (dk_buttons_and_leds)"
	select DK_LIBRARY
	help
	  Use the Nordic DK convenience library.  Works out-of-the-box on
	  nRF7002DK and nRF54LM20DK.

config ZEGO_BUTTON_BACKEND_GPIO
	bool "Zephyr Input subsystem (gpio-keys)"
	select INPUT
	help
	  Use the Zephyr Input subsystem with the gpio-keys driver.
	  Board DTS gpio-keys button nodes must assign consecutive linux,code
	  values starting from 0 (0 = button 0, 1 = button 1, …).  Provide
	  a DTS overlay in zego/button/boards/<board>.overlay if the upstream
	  board DTS uses different values.

endchoice # ZEGO_BUTTON_BACKEND

# ---------------------------------------------------------------------------
# Button count and timing
# ---------------------------------------------------------------------------

config ZEGO_BUTTON_NUM_BUTTONS
	int "Number of buttons to monitor"
	default 4
	range 1 4
	help
	  Number of buttons to monitor (0-based indices 0 to N-1).
	  Override this in boards/<board>.conf:
	    nrf7002dk_nrf5340_cpuapp      → 2  (Button 1, Button 2)
	    nrf54lm20dk_nrf54lm20a_cpuapp → 4  (BUTTON0–BUTTON3)
	  Note: when nrf54lm20dk is used with -DSHIELD=nrf7002eb2 the shield
	  occupies BUTTON3; override to 3 in the application's own
	  boards/<board>.conf.

config ZEGO_BUTTON_LONG_PRESS_MS
	int "Long-press threshold (ms)"
	default 3000
	help
	  Press duration (ms) at which a BUTTON_LONG_PRESS event is published.
	  The event fires while the button is still held.

config ZEGO_BUTTON_DOUBLE_CLICK_WINDOW_MS
	int "Double-click detection window (ms)"
	default 300
	help
	  Maximum interval between two presses to detect a BUTTON_DOUBLE_CLICK.
	  After a press+release the module waits this long for a 2nd press.
	  If none arrives, BUTTON_SINGLE_CLICK is published instead.

config ZEGO_BUTTON_LONG_PRESS_REPEAT_MS
	int "Long-press repeat interval (ms, 0 = disabled)"
	default 0
	range 0 10000
	help
	  When non-zero, BUTTON_LONG_PRESS is re-published at this interval
	  while the button remains held after the initial long-press threshold.
	  Useful for actions like volume ramping or hold-to-confirm sequences.
	  Set to 0 (default) to publish only once at the threshold.

config ZEGO_BUTTON_INIT_PRIORITY
	int "Initialization priority (SYS_INIT APPLICATION level)"
	default 90
	help
	  SYS_INIT priority for the button module.  Must be greater than the
	  chosen backend's own init priority.

module = ZEGO_BUTTON
module-str = zego_button
source "subsys/logging/Kconfig.template.log_config"

endif # ZEGO_BUTTON
```

## button/boards/nrf54lm20dk_nrf54lm20a_cpuapp.conf
```kconfig
# nRF54LM20DK — 4 user buttons (BUTTON0–BUTTON3).
#
# When building with -DSHIELD=nrf7002eb2 the shield occupies the BUTTON3 pin,
# so BUTTON3 is physically unavailable in that configuration.  That is an
# application-level constraint: the button module always tracks all 4 buttons;
# the application (e.g. nordic-wifi-webdash) overrides to NUM_BUTTONS=3 in its
# own boards/<board>.conf when the shield is present.
CONFIG_ZEGO_BUTTON_NUM_BUTTONS=4
CONFIG_ZEGO_BUTTON_BACKEND_DK=y
# To switch to the Zephyr Input backend add a DTS overlay that assigns
# linux,code = <0>..<3> to the four button nodes, then set:
#   CONFIG_ZEGO_BUTTON_BACKEND_GPIO=y
```

## button/boards/nrf7002dk_nrf5340_cpuapp.conf
```kconfig
# nRF7002 DK — 2 user buttons (Button 1 = BIT(0), Button 2 = BIT(1))
CONFIG_ZEGO_BUTTON_NUM_BUTTONS=2
```

## button/sample/boards/nrf54lm20dk_nrf54lm20a_cpuapp.conf
```kconfig
# nRF54LM20DK standalone — 4 user buttons (BUTTON0–BUTTON3).
# When building with -DSHIELD=nrf7002eb2, override to 3 via:
#   -DCONFIG_ZEGO_BUTTON_NUM_BUTTONS=3
# because the shield occupies the BUTTON3 pin.
CONFIG_ZEGO_BUTTON_NUM_BUTTONS=4
```

## button/test/testcase.yaml
```yaml
tests:
  zego.button.unit:
    tags: zego button ztest
    platform_allow: native_sim
    integration_platforms:
      - native_sim
```
