## bricks/button/boards/nrf7002dk_nrf5340_cpuapp.conf
```kconfig
# nRF7002 DK — 2 user buttons (Button 1 = BIT(0), Button 2 = BIT(1))
CONFIG_ZEGO_BUTTON_NUM_BUTTONS=2
CONFIG_ZEGO_BUTTON_BACKEND_DK=y
# To switch to the Zephyr Input backend add a DTS overlay that assigns
# linux,code = <0> and <1> to the two button nodes, then set:
#   CONFIG_ZEGO_BUTTON_BACKEND_GPIO=y
```

## bricks/button/sample/boards/nrf5340_audio_dk_nrf5340_cpuapp.conf
```kconfig
# nRF5340 Audio DK — 5 user buttons
# Index mapping (DK bitmask order):
#   0 → VOL-    (KEY_VOLUMEDOWN)
#   1 → VOL+    (KEY_VOLUMEUP)
#   2 → PLAY/PAUSE (KEY_3)
#   3 → BTN4    (KEY_4)
#   4 → BTN5    (KEY_5)
CONFIG_ZEGO_BUTTON_NUM_BUTTONS=5
CONFIG_ZEGO_BUTTON_BACKEND_DK=y
```

## bricks/button/sample/boards/nrf7002dk_nrf5340_cpuapp.conf
```kconfig
# nRF7002DK — 2 user buttons (Button 1 = idx 0, Button 2 = idx 1).
CONFIG_ZEGO_BUTTON_NUM_BUTTONS=2
CONFIG_ZEGO_BUTTON_BACKEND_DK=y
```

## bricks/led/Kconfig
```kconfig
#
# Copyright (c) 2026 Nordic Semiconductor ASA
# SPDX-License-Identifier: LicenseRef-Nordic-5-Clause
#

config ZEGO_LED
	bool "Zego LED module"
	select ZBUS
	select SMF
	help
	  Enable LED control using an SMF state machine.  Subscribes to
	  LED_CMD_CHAN (zbus) and drives LEDs.  Publishes LED_STATE_CHAN once
	  when a command takes effect (no per-toggle publishes during effects).
	  The module auto-initializes via SYS_INIT.

	  Publish to LED_CMD_CHAN with struct led_msg to command an LED.
	  See zego/led/docs/led-spec.md for the integration guide.

	  Select a hardware backend below (ZEGO_LED_BACKEND_DK or _ZEPHYR).

if ZEGO_LED

# ---------------------------------------------------------------------------
# Hardware backend
# ---------------------------------------------------------------------------

choice ZEGO_LED_BACKEND
	prompt "LED hardware backend"
	default ZEGO_LED_BACKEND_DK
	help
	  Select how the LED module drives the physical LEDs.

config ZEGO_LED_BACKEND_DK
	bool "Nordic DK library (dk_buttons_and_leds)"
	select DK_LIBRARY
	help
	  Use the Nordic DK convenience library.  Works out-of-the-box on
	  nRF7002DK and nRF54LM20DK.  Always uses software PWM for the breathe
	  effect (no hardware PWM support in this backend).

config ZEGO_LED_BACKEND_ZEPHYR
	bool "Zephyr LED driver API (gpio-leds / pwm-leds)"
	select LED
	help
	  Use the Zephyr LED driver API.  Requires a gpio-leds DTS node to be
	  present and enabled on the board.  Optionally supports hardware PWM
	  for the breathe effect — see CONFIG_ZEGO_LED_USE_PWM.

endchoice # ZEGO_LED_BACKEND

# ---------------------------------------------------------------------------
# Hardware PWM (Zephyr backend only)
# ---------------------------------------------------------------------------

config ZEGO_LED_USE_PWM
	bool "Use hardware PWM for the breathe effect where available"
	depends on ZEGO_LED_BACKEND_ZEPHYR
	select LED_PWM
	help
	  When enabled, LEDs that have a corresponding pwm-leds device entry
	  will use hardware PWM for the breathe effect.  This offloads the PWM
	  signal to dedicated hardware, eliminating the per-frame CPU wake-ups
	  of the software-PWM fallback and producing a smoother fade.

	  Configure which LED maps to which pwm-leds child index via
	  ZEGO_LED_n_PWM_INDEX (n = 0..3).  Set to -1 for LEDs that have no
	  PWM channel; those LEDs fall back to software PWM automatically.

	  Board examples:
	    nrf7002dk:   LED0 → pwm-leds index 0  (only LED0 has HW PWM)
	    nrf54lm20dk: LED1 → pwm-leds index 0  (only LED1 has HW PWM)

if ZEGO_LED_USE_PWM

config ZEGO_LED_0_PWM_INDEX
	int "pwm-leds child index for LED 0 (-1 = software PWM fallback)"
	default -1
	range -1 8
	help
	  Index of this LED within the board's pwm-leds device.
	  Set to -1 to use software PWM for LED 0.

config ZEGO_LED_1_PWM_INDEX
	int "pwm-leds child index for LED 1 (-1 = software PWM fallback)"
	default -1
	range -1 8

config ZEGO_LED_2_PWM_INDEX
	int "pwm-leds child index for LED 2 (-1 = software PWM fallback)"
	default -1
	range -1 8

config ZEGO_LED_3_PWM_INDEX
	int "pwm-leds child index for LED 3 (-1 = software PWM fallback)"
	default -1
	range -1 8

endif # ZEGO_LED_USE_PWM

# ---------------------------------------------------------------------------
# LED count and effect timings
# ---------------------------------------------------------------------------

config ZEGO_LED_NUM_LEDS
	int "Number of LEDs to control"
	default 4
	range 1 9
	help
	  Number of LEDs to manage (0-based indices 0 to N-1).
	  Override this in boards/<board>.conf:
	    nrf7002dk_nrf5340_cpuapp           → 2
	    nrf54lm20dk_nrf54lm20a_cpuapp      → 4
	    nrf5340_audio_dk_nrf5340_cpuapp    → 9 (RGB1 + RGB2 + 3 mono)

config ZEGO_LED_CMD_QUEUE_DEPTH
	int "LED command queue depth"
	default 8
	range 2 32
	help
	  Maximum number of LED_CMD_CHAN messages buffered between the zbus
	  listener (which runs in the publisher's thread) and the SMF worker
	  (which runs on the system workqueue).  Increase this if LOG_WRN
	  "LED command queue full" appears during rapid command bursts.

config ZEGO_LED_INIT_PRIORITY
	int "Initialization priority (SYS_INIT APPLICATION level)"
	default 91
	help
	  SYS_INIT priority for the LED module.  Must be greater than the
	  chosen backend's own init priority.  Set higher than
	  ZEGO_BUTTON_INIT_PRIORITY if both modules are enabled.

config ZEGO_LED_BLINK_PERIOD_MS
	int "Default blink half-period in milliseconds"
	default 250
	range 50 10000
	help
	  Time the LED stays on (and off) for each blink half-cycle when
	  LED_COMMAND_BLINK is sent with period_ms = 0.  Full cycle = 2x this value.

config ZEGO_LED_BREATHE_PERIOD_MS
	int "Breathe ramp duration per direction in milliseconds"
	default 3000
	range 200 30000
	help
	  Time for one ramp direction (fade-up or fade-down) when
	  LED_COMMAND_BREATHE is sent with period_ms = 0.
	  Full cycle = 2 × this value (default: 3 s up + 3 s down = 6 s total).
	  Number of PWM steps = this value / CONFIG_ZEGO_LED_BREATHE_PWM_PERIOD_MS.

config ZEGO_LED_BREATHE_PWM_PERIOD_MS
	int "Breathe PWM frame duration in milliseconds"
	default 20
	range 5 100
	help
	  For software-PWM breathe: duration of one PWM cycle.  Lower values
	  give finer brightness resolution; higher values reduce CPU wake-ups.
	  Default 20 ms (50 Hz) gives 150 steps per 3 s ramp.

	  For hardware-PWM breathe (CONFIG_ZEGO_LED_USE_PWM=y): this is the
	  ramp step interval — time between successive brightness updates sent
	  to the PWM peripheral.

config ZEGO_LED_ROTATE_PERIOD_MS
	int "Default rotate step period in milliseconds"
	default 500
	range 50 5000
	help
	  Time each LED stays lit during the rotate sweep when
	  LED_COMMAND_ROTATE is sent with period_ms = 0.

config ZEGO_LED_ROTATE_NUM_LEDS
	int "Number of LEDs participating in the rotate sweep"
	default ZEGO_LED_NUM_LEDS
	range 1 9
	help
	  Number of LEDs (starting from index 0) that cycle during the rotate
	  effect.  Defaults to all managed LEDs (ZEGO_LED_NUM_LEDS).  Set to a
	  smaller value to restrict the sweep to a leading subset of LEDs.
	  Example: nRF5340 Audio DK sets this to 3 so the rotate cycles only
	  the RGB1 triplet (indices 0-2), leaving RGB2 and mono LEDs off.

module = ZEGO_LED
module-str = zego_led
source "subsys/logging/Kconfig.template.log_config"

endif # ZEGO_LED
```

## bricks/led/boards/nrf7002dk_nrf5340_cpuapp.conf
```kconfig
# nRF7002 DK — 2 user LEDs (LED1 = index 0, LED2 = index 1)
CONFIG_ZEGO_LED_NUM_LEDS=2
CONFIG_ZEGO_LED_BACKEND_DK=y
# To use the Zephyr LED driver backend (required for hardware-PWM breathe):
#   CONFIG_ZEGO_LED_BACKEND_ZEPHYR=y
#   CONFIG_ZEGO_LED_USE_PWM=y
#   CONFIG_ZEGO_LED_0_PWM_INDEX=0   # LED0 → pwm-leds child index 0 (pwm_led_0)
#   CONFIG_ZEGO_LED_1_PWM_INDEX=-1  # LED1 → GPIO only, software PWM fallback
```

## bricks/led/sample/boards/nrf5340_audio_dk_nrf5340_cpuapp.conf
```kconfig
# nRF5340 Audio DK — 9 LEDs
# Index mapping:
#   0-2 → RGB1 (led_0/1/2, PWM-capable)
#   3-5 → RGB2 (led_3/4/5)
#   6   → mono blue  (led_6)
#   7-8 → mono green (led_7/8)
# Marquee restricted to RGB1 (indices 0-2) so it cycles the RGB triplet only.
CONFIG_ZEGO_LED_NUM_LEDS=9
CONFIG_ZEGO_LED_ROTATE_NUM_LEDS=3
CONFIG_ZEGO_LED_BACKEND_DK=y
```

## bricks/memonitor/Kconfig
```kconfig
#
# Copyright (c) 2026 Nordic Semiconductor ASA
# SPDX-License-Identifier: LicenseRef-Nordic-5-Clause
#

config ZEGO_MEMONITOR
	bool "Periodic memory and thread watermark monitor"
	depends on ZBUS
	default n
	help
	  Firmware-side periodic sampler. Fires every ZEGO_MEMONITOR_INTERVAL_MS
	  on the system work queue, captures heap and thread snapshots, and
	  publishes MEMONITOR_CHAN so consumers (e.g. web dashboard) can read
	  the data via memonitor_get_heaps() / memonitor_get_threads().

	  This is independent of ZView. ZView reads memory directly over SWD/JTAG
	  at its own rate and does not require this brick to be enabled.
	  Enable ZEGO_MEMONITOR_ZVIEW to auto-select the Kconfig symbols that
	  ZView needs (INIT_STACKS, THREAD_MONITOR, etc.).

if ZEGO_MEMONITOR

config ZEGO_MEMONITOR_ZVIEW
	bool "ZView Kconfig dependencies (SWD/JTAG live monitor)"
	depends on !STACK_SENTINEL
	select INIT_STACKS
	select THREAD_MONITOR
	select THREAD_STACK_INFO
	select THREAD_NAME
	select THREAD_RUNTIME_STATS
	select THREAD_RUNTIME_STATS_USE_TIMING_FUNCTIONS
	select SYS_HEAP_RUNTIME_STATS
	select NET_BUF_POOL_USAGE if NETWORKING
	default n
	help
	  ZView is a host-side tool that reads heap and thread data directly
	  over SWD/JTAG. It does not go through the firmware sampler and is not
	  affected by ZEGO_MEMONITOR_INTERVAL_MS.

	  This option auto-selects the Kconfig symbols ZView requires to read
	  thread stack watermarks and heap peak usage from the target ELF:
	    CONFIG_INIT_STACKS         — fills stacks with 0xaa (watermark base)
	    CONFIG_THREAD_MONITOR      — thread list accessible via kernel API
	    CONFIG_THREAD_STACK_INFO   — stack address/size metadata in k_thread
	    CONFIG_THREAD_NAME         — thread name strings in ELF
	    CONFIG_THREAD_RUNTIME_STATS    — CPU usage counters
	    CONFIG_THREAD_RUNTIME_STATS_USE_TIMING_FUNCTIONS — accurate CPU%
	                                     via hardware timer
	    CONFIG_SYS_HEAP_RUNTIME_STATS  — heap peak/allocated fields
	    CONFIG_NET_BUF_POOL_USAGE      — net_buf pool stats visible as heaps
	                                     (only when NETWORKING=y)

	  CONFIG_STACK_SENTINEL must remain n (enforced by "depends on
	  !STACK_SENTINEL"): sentinel overwrites the 0xaa fill with 0xf0f0f0f0,
	  causing ZView to report 100% stack usage on every thread.

config ZEGO_MEMONITOR_HEAP_MONITOR
	bool "Heap watermark sampling (firmware-side)"
	depends on SYS_HEAP_RUNTIME_STATS
	default y
	help
	  Firmware-side heap sampler. Captures all k_heap instances via
	  STRUCT_SECTION_FOREACH every ZEGO_MEMONITOR_INTERVAL_MS and caches
	  the result for consumers (e.g. web dashboard /api/heaps endpoint).
	  When CONFIG_MBEDTLS_ENABLE_HEAP=y the mbedTLS heap is appended as
	  "mbedtls_heap".
	  Requires CONFIG_SYS_HEAP_RUNTIME_STATS=y.

	  ZView reads heap data directly over SWD/JTAG independent of this
	  setting; ZEGO_MEMONITOR_ZVIEW controls the Kconfig ZView needs.

config ZEGO_MEMONITOR_THREAD_MONITOR
	bool "Thread stack watermark sampling (firmware-side)"
	depends on THREAD_STACK_INFO
	depends on INIT_STACKS
	default y
	help
	  Firmware-side thread sampler. Captures stack HWM, state, and name for
	  all Zephyr threads every ZEGO_MEMONITOR_INTERVAL_MS and caches the
	  result for consumers (e.g. web dashboard /api/threads endpoint).
	  Requires CONFIG_THREAD_STACK_INFO=y and CONFIG_INIT_STACKS=y.
	  CONFIG_STACK_SENTINEL must be n — enabling it overwrites the 0xaa
	  stack-init fill with 0xf0f0f0f0, causing 100% watermarks on all threads.

	  ZView reads thread stack data directly over SWD/JTAG independent of
	  this setting; ZEGO_MEMONITOR_ZVIEW controls the Kconfig ZView needs.

config ZEGO_MEMONITOR_INTERVAL_MS
	int "Firmware sampler interval (milliseconds)"
	default 2000
	range 100 60000
	help
	  Controls how often the firmware-side sampler (HEAP_MONITOR +
	  THREAD_MONITOR) fires on the system work queue.
	  This setting has no effect on ZView, which reads heap and stack data
	  directly over SWD/JTAG at its own host-controlled rate.

config ZEGO_MEMONITOR_LOG_PERIODIC
	bool "Log heap and thread watermarks to UART on each sample"
	default n
	help
	  On every sample interval emit a compact INF log line per tracked heap
	  (name, HWM, total, %) and per tracked thread (name, HWM, stack size, %).
	  Useful for field monitoring without ZView attached.
	  Default n — log format strings consume flash. Enable selectively on boards
	  with sufficient flash headroom (e.g. nRF54LM20DK). Leave n on nRF7002DK.

config ZEGO_MEMONITOR_LOG_LEVEL
	int "Log level for memonitor"
	default 3
	range 0 4
	help
	  0=OFF  1=ERR  2=WRN  3=INF  4=DBG

# When MBEDTLS_ENABLE_HEAP is active the memonitor samples the mbedTLS heap
# and exposes zview_mbedtls_stats for ZView.  MBEDTLS_MEMORY_DEBUG is required
# to read cur/peak usage via mbedtls_memory_buffer_alloc_cur_get() /
# _max_get().  Select it automatically so no board conf entry is needed.
config MBEDTLS_MEMORY_DEBUG
	bool
	default y if MBEDTLS_ENABLE_HEAP

endif # ZEGO_MEMONITOR
```
